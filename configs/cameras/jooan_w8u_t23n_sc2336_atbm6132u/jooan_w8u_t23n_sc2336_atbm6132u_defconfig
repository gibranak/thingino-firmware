## configs/cameras/jooan_w8u_t23n_sc2336_atbm6132u/jooan_w8u_t23n_sc2336_atbm6132u_defconfig
```kconfig
# NAME: Jooan W8-U (T23N, SC2336P, ATBM6132U)
# FRAG: soc-xburst1 core
BR2_INGENIC_SOC_MODEL="t23n"
BR2_ISP_CLK_200MHZ=y
BR2_ISP_DIRECT_MODE_2=y
BR2_ISP_IVDC_MEM_LINE=y
BR2_ISP_IVDC_MEM_LINE_VALUE=540
BR2_ISP_MEMOPT_1=y
BR2_ISP_PARAMS="mipi_switch_gpio=7"
BR2_PACKAGE_THINGINO_KOPT_MMC0=y
BR2_PACKAGE_THINGINO_KOPT_MMC0_PB_4BIT=y
BR2_PACKAGE_THINGINO_RAPTOR_CONF_AUDIO_CODEC="pcmu"
BR2_PACKAGE_THINGINO_RAPTOR_CONF_AUDIO_SAMPLE_RATE="8000"
BR2_PACKAGE_THINGINO_RAPTOR_CONF_JPEG_ENABLED_FALSE=y
BR2_PACKAGE_THINGINO_RAPTOR_CONF_OSD_ISP_OSD_TRUE=y
BR2_PACKAGE_THINGINO_RAPTOR_CONF_RTSP_ENDPOINT_S1_MAIN="ch2"
BR2_PACKAGE_THINGINO_RAPTOR_CONF_RTSP_ENDPOINT_S1_SUB="ch3"
BR2_PACKAGE_THINGINO_RAPTOR_CONF_RTSP_MAX_CLIENTS="8"
BR2_PACKAGE_THINGINO_RAPTOR_CONF_S1S0_CODEC="h264"
BR2_PACKAGE_THINGINO_RAPTOR_CONF_S1S0_FPS="15"
BR2_PACKAGE_THINGINO_RAPTOR_CONF_S1S0_IVDC_TRUE=y
BR2_PACKAGE_THINGINO_RAPTOR_CONF_S1S1_CODEC="h264"
BR2_PACKAGE_THINGINO_RAPTOR_CONF_S1S1_FPS="15"
BR2_PACKAGE_THINGINO_RAPTOR_CONF_SENSOR0_FPS="15"
BR2_PACKAGE_THINGINO_RAPTOR_CONF_SENSOR0_HEIGHT="1080"
BR2_PACKAGE_THINGINO_RAPTOR_CONF_SENSOR0_I2C_ADDR="0x30"
BR2_PACKAGE_THINGINO_RAPTOR_CONF_SENSOR0_NAME="sc2336p"
BR2_PACKAGE_THINGINO_RAPTOR_CONF_SENSOR0_WIDTH="1920"
BR2_PACKAGE_THINGINO_RAPTOR_CONF_SENSOR1_FPS="15"
BR2_PACKAGE_THINGINO_RAPTOR_CONF_SENSOR1_HEIGHT="1080"
BR2_PACKAGE_THINGINO_RAPTOR_CONF_SENSOR1_I2C_ADDR="0x32"
BR2_PACKAGE_THINGINO_RAPTOR_CONF_SENSOR1_NAME="sc2336ps1"
BR2_PACKAGE_THINGINO_RAPTOR_CONF_SENSOR1_WIDTH="1920"
BR2_PACKAGE_THINGINO_RAPTOR_CONF_STREAM0_FPS="15"
BR2_PACKAGE_THINGINO_RAPTOR_CONF_STREAM0_IVDC_TRUE=y
BR2_PACKAGE_THINGINO_RAPTOR_CONF_STREAM1_FPS="15"
BR2_PACKAGE_WIFI=y
BR2_PACKAGE_WIFI_ATBM6132U=y
BR2_SENSOR_1_NAME="sc2336ps0"
BR2_SENSOR_1_PARAMS="reset_gpio=-1"
BR2_SENSOR_2_NAME="sc2336ps1"
BR2_SENSOR_2_PARAMS="reset_gpio=-1 rotate180=1"
BR2_THINGINO_AUDIO=y
BR2_THINGINO_BUTTON=y
BR2_THINGINO_IMAGE_SENSOR_QTY=2
BR2_THINGINO_MOTORS=y
BR2_THINGINO_PWM_ENABLE=y
BR2_THINGINO_RMEM_MB=24
BR2_THINGINO_SDCARD=y
FLASH_SIZE_MB=8
```
